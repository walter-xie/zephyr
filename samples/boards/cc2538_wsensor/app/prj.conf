## CMakeLists.txt
```
set(BOARD cc2538_wsensor)
set (XMODEM_LOADER n)
include($ENV{ZEPHYR_BASE}/cmake/app/boilerplate.cmake NO_POLICY_SCOPE)
project(NONE)

target_include_directories(app PRIVATE $ENV{ZEPHYR_BASE}/subsys/net/ip)
FILE(GLOB app_sources src/*.c)
target_sources(app PRIVATE ${app_sources})
```

## sample.yaml
```
sample:
  description: xmodem boot loader for cc2538_wsensor board.
    application
  name: xmodem loader
  platforms: cc2538_wsensor
common:
    tags: samples
    harness: console
    harness_config:
      type: one_line
      regex:
        - ""
tests:
  singlethread:
    extra_args: CONF_FILE=prj_single.conf
    filter: not CONFIG_BT and not CONFIG_GPIO_SCH and ASSERT == 0
  test:
    tags: samples
```

## prj.conf
```kconfig
CONFIG_MULTITHREADING=y
CONFIG_GEN_ISR_TABLES=y
CONFIG_GEN_IRQ_VECTOR_TABLE=y
CONFIG_GEN_SW_ISR_TABLE=y
CONFIG_TI_CCFG_PRESENT=n

CONFIG_KERNEL_DEBUG=n
CONFIG_TICKLESS_KERNEL=n
CONFIG_BOOT_BANNER=n

CONFIG_UART_STELLARIS_PORT_0=y

CONFIG_KERNEL_SHELL=y
CONFIG_REBOOT=y

# Enable basic networking
CONFIG_NETWORKING=y

# 802.15.4 requires random generator
CONFIG_TEST_RANDOM_GENERATOR=y

# Network Interface Buffer Size
#CONFIG_NET_BUF_DATA_SIZE=300
CONFIG_NET_PKT_RX_COUNT=30
CONFIG_NET_BUF_RX_COUNT=16
CONFIG_NET_PKT_TX_COUNT=5
CONFIG_NET_BUF_TX_COUNT=16

CONFIG_NET_DEBUG_NET_PKT=n
CONFIG_NET_DEBUG_NET_PKT_ALL=n

#### Logging Configuration ############################
#SYS_LOG_NET_LEVEL  OFF:0 ERROR:1 WARNING:2 INFO:3 DEBUG:4
CONFIG_SYS_LOG=y
CONFIG_NET_LOG=y
CONFIG_SYS_LOG_NET_LEVEL=4
CONFIG_SYS_LOG_SHOW_COLOR=y

#### Network Stack Configuration ######################

# RPL (Routing)
CONFIG_NET_RPL=y
CONFIG_NET_DEBUG_RPL=n
CONFIG_NET_RPL_GROUNDED=y
CONFIG_NET_RPL_MAX_DAG_PER_INSTANCE=1
#CONFIG_NET_RPL_PREFIX="2001:db8::1/64"
CONFIG_NET_RPL_MAX_PARENTS=1

# IPv6 (L3)
CONFIG_NET_IPV6=y
CONFIG_NET_DEBUG_IPV6=y
CONFIG_NET_IPV6_ND=n
CONFIG_NET_IPV6_DAD=n
CONFIG_NET_IPV6_MLD=n
#CONFIG_NET_IPV6_MAX_NEIGHBORS=10
CONFIG_NET_MAX_ROUTES=10

# 6LoWPAN (L2 - Adaptation Layer)
CONFIG_NET_6LO=y
CONFIG_NET_DEBUG_6LO=y

# 802.15.4 (L2)
CONFIG_NET_L2_IEEE802154=y
CONFIG_NET_L2_IEEE802154_FRAGMENT=y
CONFIG_NET_DEBUG_L2_IEEE802154=n
CONFIG_NET_DEBUG_L2_IEEE802154_FRAGMENT=n
CONFIG_NET_DEBUG_L2_IEEE802154_DISPLAY_PACKET=n
CONFIG_NET_DEBUG_L2_IEEE802154_DISPLAY_PACKET_TX=n
CONFIG_NET_DEBUG_L2_IEEE802154_DISPLAY_PACKET_FULL=n

# 802.15.4 (L1)
#SYS_LOG_IEEE802154_DRIVER_LEVEL  OFF:0 ERROR:1 WARNING:2 INFO:3 DEBUG:4
CONFIG_IEEE802154_CC2538=y
CONFIG_IEEE802154_CC2538_DEBUG=n

CONFIG_NET_DEBUG_IF=n


#### Additional Configuration #########################

# Enabled Shell Extensions
CONFIG_NET_SHELL=y
CONFIG_NET_L2_IEEE802154_SHELL=y


# Application Settings
CONFIG_NET_APP_SETTINGS=y
CONFIG_NET_APP_INIT_TIMEOUT=5
CONFIG_NET_APP_IEEE802154_DEV_NAME="IEEE802154_cc2538"
CONFIG_NET_APP_IEEE802154_CHANNEL=11
CONFIG_NET_APP_IEEE802154_RADIO_TX_POWER=3
CONFIG_NET_APP_IEEE802154_PAN_ID=0x1234

#CONFIG_NET_L2_IEEE802154_SECURITY=y
#CONFIG_NET_APP_IEEE802154_SECURITY_KEY="key"
#CONFIG_NET_APP_IEEE802154_SECURITY_KEY_MODE=0
#CONFIG_NET_APP_IEEE802154_SECURITY_LEVEL=0

CONFIG_NET_DEBUG_APP=n
#CONFIG_NET_APP_MY_IPV6_ADDR="2001:db8::1"
```

## src/main.c
```c
/*
 * Copyright (c) 2017 CPqD Foundation
 *
 * SPDX-License-Identifier: Apache-2.0
 */

#include <zephyr.h>
#include <misc/printk.h>
#include <stdlib.h>
#include <rpl.h>
#include <watchdog.h>
#include <uart.h>

#define CURRENT_VERSION 0

#define WATCHDOG_DEV_NAME "WDT"


static void create_root_dag(void)
{
    struct net_if *iface = net_if_get_default();
	if (!iface) {
		printk("Interface is NULL\n");
		printk("Failed to setup RPL root node\n");
		return;
	}

	u8_t init_version = CURRENT_VERSION;
	/* Check the current version */
	#if (CURRENT_VERSION == 0) 
	/* case 0 - call init */
	init_version = net_rpl_lollipop_init();
	#elif (CURRENT_VERSION > 0) 
	/* case > 0 - increment */
	net_rpl_lollipop_increment(&init_version);
	#endif
	
	struct in6_addr ipv6_addr;
	net_ipv6_addr_create_iid(&ipv6_addr ,net_if_get_link_addr(iface));
	/* Setup the root node */
    printk("RPL border router starting\n");
	struct net_rpl_dag *dag = net_rpl_set_root_with_version(iface, CONFIG_NET_RPL_DEFAULT_INSTANCE, &ipv6_addr, init_version);
	if (!dag) {
		printk("Cannot set root node");
		return;
	}
	
	if (!net_rpl_set_prefix(iface, dag, &ipv6_addr, 16)) {
		printk("Cannot set prefix");
	}
}

static struct device *wdg_dev=(struct device *)0;
void main(void)
{
	wdg_dev = device_get_binding(WATCHDOG_DEV_NAME);
	wdt_reload(wdg_dev);
	create_root_dag();
    while(1)
	{
		wdt_reload(wdg_dev);
		k_sleep(300);
	}
}
```
